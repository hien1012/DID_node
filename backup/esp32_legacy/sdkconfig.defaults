## main/Kconfig.projbuild
```kconfig
menu "Field Data Collection"
    config FIELD_WIFI_SSID
        string "Wi-Fi SSID"
        default ""

    config FIELD_WIFI_PASSWORD
        string "Wi-Fi password"
        default ""

    config FIELD_SERVER_BASE_URL
        string "Server base URL"
        default "http://140.123.91.132:5000"

endmenu
```
